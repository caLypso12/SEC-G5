/ {
	amba_pl: amba_pl {
		ranges;
		compatible = "simple-bus";
		#address-cells = <1>;
		#size-cells = <1>;
		axil_conv2D_0: axil_conv2D@40000000 {
			compatible = "xlnx,axil-conv2D-1.0";
			xlnx,ii = <66582>;
			xlnx,machine = <64>;
			xlnx,s-axi-bus1-data-width = <32>;
			xlnx,rable = <0>;
			xlnx,ip-name = "axil_conv2D";
			reg = <0x40000000 0x10000>;
			clocks = <&clkc 15>;
			xlnx,clk-period = <10>;
			xlnx,edk-iptype = "PERIPHERAL";
			status = "okay";
			clock-names = "ap_clk";
			xlnx,s-axi-bus1-addr-width = <15>;
			xlnx,combinational = <0>;
			xlnx,latency = <66581>;
			xlnx,name = "axil_conv2D_0";
		};
	};
};
